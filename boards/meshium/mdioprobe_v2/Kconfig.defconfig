## boards/meshium/mdioprobe_v2/Kconfig.mdioprobe_v2
```kconfig
# Copyright (c) 2026 Meshium
# SPDX-License-Identifier: Apache-2.0

config BOARD_MDIOPROBE_V2
	select SOC_STM32G474XX
```

## boards/meshium/mdioprobe_v2/board.yml
```yaml
board:
  name: mdioprobe_v2
  full_name: MDIO Probe v2
  vendor: meshium
  socs:
    - name: stm32g474xx
```
